## app/drivers/Kconfig
```kconfig
menu "Custom Ethernet Drivers"

config ETH_KSZ8851SNL
	bool "KSZ8851SNL SPI Ethernet Driver"
	default y
	depends on SPI
	help
	  Enable KSZ8851SNL SPI Ethernet driver.
	  This driver provides full network stack integration
	  for the Microchip KSZ8851SNL 10/100 Ethernet controller.

if ETH_KSZ8851SNL

config ETH_INIT_PRIORITY
	int "Ethernet driver initialization priority"
	default 80
	help
	  KSZ8851SNL driver initialization priority. Must be higher
	  than SPI driver priority.

endif # ETH_KSZ8851SNL

endmenu
```

## drivers/ethernet/Kconfig
```kconfig
# Ethernet drivers configuration options

# Copyright (c) 2015 Intel Corporation
# SPDX-License-Identifier: Apache-2.0

menuconfig ETH_DRIVER
	bool "Ethernet drivers"
	depends on NETWORKING
	depends on !NET_TEST
	default y if NET_L2_ETHERNET

if ETH_DRIVER

config ETH_DRIVER_RAW_MODE
	bool "Ethernet driver without the MAC stack"
	select NET_RAW_MODE
	depends on !NET_L2_ETHERNET
	help
	  This option enables using the drivers in a so-called "raw" mode,
	  i.e. without a MAC stack (the net L2 layer for ethernet will not
	  be built).

# Source only the KSZ8851SNL driver that we have
rsource "Kconfig.ksz8851snl"

endif # "Ethernet Drivers"

config ETH_INIT_PRIORITY
	int "Ethernet driver init priority"
	default 80
	depends on NET_L2_ETHERNET || ETH_DRIVER
	help
	  Ethernet device driver initialization priority.
```

## west.yml
```yaml
# Copyright (c) 2021 Nordic Semiconductor ASA
# SPDX-License-Identifier: Apache-2.0

manifest:
  self:
    west-commands: scripts/west-commands.yml

  remotes:
    - name: zephyrproject-rtos
      url-base: https://github.com/zephyrproject-rtos

  projects:
    - name: zephyr
      remote: zephyrproject-rtos
      revision: v4.1.0
      import: true
  self:
    path: ksz8851-app
```
